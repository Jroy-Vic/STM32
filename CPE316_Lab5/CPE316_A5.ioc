# file: CPE316_A5.ioc
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Mcu.Family=STM32L4
Mcu.Name=STM32L476R(C-E-G)Tx
Mcu.Package=LQFP64
NVIC.PriorityGroup=NVIC_PRIORITYGROUP_4
ProjectManager.HeapSize=0x200
ProjectManager.StackSize=0x400
ProjectManager.TargetToolchain=STM32CubeIDE
RCC.HSE_VALUE=8000000
RCC.HSI_VALUE=16000000
RCC.LSE_VALUE=32768
RCC.MSI_VALUE=4000000
RCC.VCOOutputFreq_Value=32000000
board=custom

// file: Core/Src/main.c
/* USER CODE BEGIN Header */
/**
  ******************************************************************************
  * @file           : main.c
  * @brief          : Main program body
  ******************************************************************************
  * @attention
  *
  * Copyright (c) 2024 STMicroelectronics.
  * All rights reserved.
  *
  * This software is licensed under terms that can be found in the LICENSE file
  * in the root directory of this software component.
  * If no LICENSE file comes with this software, it is provided AS-IS.
  *
  ******************************************************************************
  */
/* USER CODE END Header */
#include "main.h"
#include <stdlib.h>
#include "UART.h"
#define INTEXT "Hello World!\n\r"
#define DELAY 250000

typedef enum {INIT_ST, INPUT_ST} state_t;
/* INIT_ST = ESC Code Demonstration
 * INPUT_ST = Receive Input from Keyboard
 */

void SystemClock_Config(void);

int main(void)
{

  /* USER CODE BEGIN 1 */

  /* Initialize State */
  state_t state = INIT_ST;
  /* USER CODE END 1 */

  /* MCU Configuration--------------------------------------------------------*/

  /* Reset of all peripherals, Initializes the Flash interface and the Systick. */
  HAL_Init();

  /* Configure the system clock */
  SystemClock_Config();

  /* Initialize all configured peripherals */
  /* USER CODE BEGIN 2 */
  /* Initialize UART Peripheral */
  	UART_init();

  /* USER CODE END 2 */

  /* Infinite loop */
  	while (1)
  {
	  switch (state) {
		  case INIT_ST:
			  /* Clear Entire Screen and Start at Top Left */
			  UART_ESC_Code("[2J"); // Clear Screen
			  UART_ESC_Code("[H");  // Move Cursor
			  /* Delay */
			  UART_delay(DELAY);

			  /* Move cursor down 3 lines */
			  /* Transmit Data */
			  UART_ESC_Code("[3B");
			  /* Delay */
			  UART_delay(DELAY);

			  /* Move cursor right 5 spaces */
			  /* Transmit Data */
			  UART_ESC_Code("[5C");
			  /* Delay */
			  UART_delay(DELAY);

			  /* Text "All good students read the" */
			  /* Transmit Data */
			  UART_print("All good students read the");
			  /* Delay */
			  UART_delay(DELAY);

			  /* Move cursor down 1 line */
			  /* Transmit Data */
			  UART_ESC_Code("[1B");
			  /* Delay */
			  UART_delay(DELAY);

			  /* Move cursor left 21 spaces */
			  /* Transmit Data */
			  UART_ESC_Code("[21D");
			  /* Delay */
			  UART_delay(DELAY);

			  /* Change text to blinking mode */
			  /* Transmit Data */
			  UART_ESC_Code("[5m");
			  /* Delay */
			  UART_delay(DELAY);

			  /* Text "Reference Manual" */
			  /* Transmit Data */
			  UART_print("Reference Manual");
			  /* Delay */
			  UART_delay(DELAY);

			  /* Move cursor back to top left position */
			  /* Transmit Data */
			  UART_ESC_Code("[H");
			  /* Delay */
			  UART_delay(DELAY);

			  /* Disable blinking text */
			  /* Transmit Data */
			  UART_ESC_Code("[0m");
			  /* Delay */
			  UART_delay(DELAY);

			  /* Text "Input:" */
			  /* Transmit Data */
			  UART_print("Input:");
			  /* Delay */
			  UART_delay(DELAY);

			  /* Transition to INPUT_ST */
			  state = INPUT_ST;
			  break;

		  case INPUT_ST:
			  state = INPUT_ST;
			  break;
	  }

  }
}

void SystemClock_Config(void)
{
  RCC_OscInitTypeDef RCC_OscInitStruct = {0};
  RCC_ClkInitTypeDef RCC_ClkInitStruct = {0};

  /** Configure the main internal regulator output voltage
  */
  if (HAL_PWREx_ControlVoltageScaling(PWR_REGULATOR_VOLTAGE_SCALE1) != HAL_OK)
  {
    Error_Handler();
  }

  /** Initializes the RCC Oscillators according to the specified parameters
  * in the RCC_OscInitTypeDef structure.
  */
  RCC_OscInitStruct.OscillatorType = RCC_OSCILLATORTYPE_MSI;
  RCC_OscInitStruct.MSIState = RCC_MSI_ON;
  RCC_OscInitStruct.MSICalibrationValue = 0;
  RCC_OscInitStruct.MSIClockRange = RCC_MSIRANGE_6;
  RCC_OscInitStruct.PLL.PLLState = RCC_PLL_NONE;
  if (HAL_RCC_OscConfig(&RCC_OscInitStruct) != HAL_OK)
  {
    Error_Handler();
  }

  /** Initializes the CPU, AHB and APB buses clocks
  */
  RCC_ClkInitStruct.ClockType = RCC_CLOCKTYPE_HCLK|RCC_CLOCKTYPE_SYSCLK
                              |RCC_CLOCKTYPE_PCLK1|RCC_CLOCKTYPE_PCLK2;
  RCC_ClkInitStruct.SYSCLKSource = RCC_SYSCLKSOURCE_MSI;
  RCC_ClkInitStruct.AHBCLKDivider = RCC_SYSCLK_DIV1;
  RCC_ClkInitStruct.APB1CLKDivider = RCC_HCLK_DIV1;
  RCC_ClkInitStruct.APB2CLKDivider = RCC_HCLK_DIV1;

  if (HAL_RCC_ClockConfig(&RCC_ClkInitStruct, FLASH_LATENCY_0) != HAL_OK)
  {
    Error_Handler();
  }
}

void Error_Handler(void)
{
  __disable_irq();
  while (1)
  {
  }
}
